## CMakeLists.txt
```
cmake_minimum_required(VERSION 3.20.0)

find_package(Zephyr REQUIRED HINTS $ENV{ZEPHYR_BASE})
project(6sens_rtos_bth)

FILE(GLOB app_sources src/*.c)
target_sources(app PRIVATE ${app_sources})
```

## prj.conf
```kconfig
# Debugger Support
CONFIG_UART_CONSOLE=n
CONFIG_CONSOLE=y
CONFIG_SERIAL=y

# RTT Segger Support
CONFIG_RTT_CONSOLE=y
CONFIG_USE_SEGGER_RTT=y

# Communication Bus Support
CONFIG_GPIO=y
CONFIG_SPI=y
CONFIG_I2C=y

# Hardware Support
CONFIG_SENSOR=y
CONFIG_ADC=y

# Flash Memory Support
CONFIG_FLASH=y
CONFIG_FLASH_MAP=y
CONFIG_MPU_ALLOW_FLASH_WRITE=y
```

## src/main.c
```c
/*
 * Copyright (c) 2025
 * Regis Rousseau
 * Univ Lyon, INSA Lyon, Inria, CITI, EA3720
 * SPDX-License-Identifier: Apache-2.0
 */

//  ========== includes ====================================================================
#include "app_flash.h"
#include "app_sht31.h"
#include "app_vbat.h"

//  ========== interrupt sub-routine =======================================================
void sens_work_handler(struct k_work *work_rtc)
{
	// retrieve the sensor device using the device tree API
	const struct device *sht31_dev = DEVICE_DT_GET_ONE(sensirion_sht3xd);
	if (!device_is_ready(sht31_dev)) {
        printk("%s: sensor device not ready\n", sht31_dev->name);
        return -ENODEV;
    }
	
	printk("two sensors test and W/R flash memory test\n");
 	int8_t ret = app_flash_handler(sht31_dev);
	if (ret != 1) {
		printk("failed to call sensor handler");
		return 0;
	}

	// printk("only the two sensors test: ADC & SHT31\n");

	// int16_t bat = app_adc_get_bat();
	// printk("battery level (int16): %d%%\n", bat);

	// int16_t temp = app_sht_get_temp(sht31_dev);
	// printk("SHT31 temperature (int16): %d\n", temp);

	// // small delay  between reading the temperature and humidity values
	// k_msleep(5000);

	// int16_t hum = app_sht_get_hum(sht31_dev);
	// printk("SHT31 humidity (int16): %d\n", hum);
}
K_WORK_DEFINE(sens_work, sens_work_handler);

void sens_timer_handler(struct k_timer *rtc_dum)
{
	k_work_submit(&sens_work);
}
K_TIMER_DEFINE(sens_timer, sens_timer_handler, NULL);

//  ========== main ========================================================================
int main(void)
{
	// initialize ADC device
	int8_t ret = app_adc_init();
	if (ret != 1) {
		printk("failed to initialize ADC device\n");
		return 0;
	}

	// initialize partition flash memory
	ret = app_flash_init();
	if (ret != 1) {
		printk("failed to initialize internal Flash device\n");
		return 0;
	}

	printk("Sensor SHT31 and Battery Example\n");

	// start the timer to trigger the interrupt subroutine every 30 seconds
	k_timer_start(&sens_timer, K_NO_WAIT, K_SECONDS(20));
	return 0;
}
```

## src/app_flash.c
```c
/*
 * Copyright (c) 2023
 * Regis Rousseau
 * Univ Lyon, INSA Lyon, Inria, CITI, EA3720
 * SPDX-License-Identifier: Apache-2.0
 */

//  ========== includes ====================================================================
#include "app_vbat.h"
#include "app_sht31.h"
#include "app_flash.h"

//  ========== globals =====================================================================
struct flash_header {
    uint32_t magic;
    uint32_t head;
};

//  ========== app_flash_init ==============================================================
int8_t app_flash_init()
{
	const struct flash_area *fa;
	int8_t  ret = flash_area_open(FIXED_PARTITION_ID(log_storage), &fa);
	if (ret != 0) {
    	printk("Failed to open flash area\n");
    	return -1;
	}
	
	struct flash_header hdr;
	flash_area_read(fa, FLASH_HEAD_OFFSET, &hdr, sizeof(hdr));

	if (hdr.magic != MAGIC_KEY) {
		printk("flash not initialized. initializing now.\n");

		// erase first sector
		flash_area_erase(fa, FLASH_HEAD_OFFSET, FLASH_SECTOR_SIZE);

		// write new header
		hdr.magic = MAGIC_KEY;
		hdr.head = 0;
		flash_area_write(fa, FLASH_HEAD_OFFSET, &hdr, sizeof(hdr));
	} else {
		printk("flash already initialized. head: %u\n", hdr.head);
	}
	flash_area_close(fa);
	return 1;
}

//  ========== app_flash_store =============================================================
int8_t app_flash_store(const struct vth *data)
{
    const struct flash_area *fa;
    int8_t ret = flash_area_open(FIXED_PARTITION_ID(log_storage), &fa);
    if (ret != 0) {
        printk("failed to open flash area\n");
        return -1;
    }

    // read head from the head sector
    uint32_t head = 0;
    flash_area_read(fa, 0, &head, sizeof(head));  // head at offset 0

    // compute current data offset
    uint32_t index = head % MAX_RECORDS;
    off_t data_offset = FLASH_DATA_OFFSET + index * RECORD_SIZE;

    // erase sector only when writing first record of a sector
	uint32_t records_per_sector = FLASH_SECTOR_SIZE / RECORD_SIZE;
	if ((index % records_per_sector) == 0) {
		off_t sector_offset = data_offset & ~(FLASH_SECTOR_SIZE - 1);
		ret = flash_area_erase(fa, sector_offset, FLASH_SECTOR_SIZE);
		if (ret != 0) {
			printk("erase failed at offset 0x%x\n", (uint32_t)sector_offset);
			flash_area_close(fa);
			return -1;
		}
	}

    // write record
    ret = flash_area_write(fa, data_offset, data, RECORD_SIZE);
    if (ret != 0) {
        printk("write failed at offset 0x%x\n", (uint32_t)data_offset);
        flash_area_close(fa);
        return -1;
    }
	
    // update head
    head = (head + 1) % MAX_RECORDS;
    flash_area_write(fa, 0, &head, sizeof(head));
    if (ret != 0) {
		printk("failed to update head\n");
		flash_area_close(fa);
		return -1;
	}
    flash_area_close(fa);

	    // write record
    ret = flash_area_write(fa, data_offset, data, RECORD_SIZE);
    if (ret != 0) {
        printk("write failed at offset 0x%x\n", (uint32_t)data_offset);
        flash_area_close(fa);
        return -1;
    }

    // ================= READ BACK =================
    struct vth verify_data;

    ret = flash_area_read(fa, data_offset,
                          &verify_data,
                          RECORD_SIZE);

    if (ret != 0) {
        printk("read failed\n");
        flash_area_close(fa);
        return -1;
    }

    printk("WRITE : temp=%d hum=%d vbat=%d\n",
           data->temp,
           data->hum,
           data->vbat);

    printk("READ  : temp=%d hum=%d vbat=%d\n",
           verify_data.temp,
           verify_data.hum,
           verify_data.vbat);

    return 0;
}

//  ========== app_flash_handler ===========================================================
int8_t app_flash_handler(const struct device *dev)
{
	struct vth data;

	// retrieve the sensor device using the device tree API
	if (!device_is_ready(dev)) {
        printk("%s: sensor device not ready\n", dev->name);
        return -1;
    }

	// collect sensor data until the maximum number of records is reached
	// measure and store the battery voltage
	data.vbat = app_adc_get_bat();

	// measure and store the temperature using the SHT31 sensor
	data.temp = app_sht_get_temp(dev);

	// small delay  between reading the temperature and humidity values
	k_msleep(5000);		

	// measure and store the humidity using the SHT31 sensor
	data.hum = app_sht_get_hum(dev);

	// save the collected sensor data into the flash memory
	int8_t ret = app_flash_store(&data);
    return 1;
}
```

## src/app_sht31.c
```c
/*
 * Copyright (c) 2025
 * Regis Rousseau
 * Univ Lyon, INSA Lyon, Inria, CITI, EA3720
 * SPDX-License-Identifier: Apache-2.0
 */

//  ========== includes ====================================================================
#include "app_sht31.h"

//  ========== app_sht31_get_temp ==========================================================
int16_t app_get_temp(const struct device *dev)
{
    struct sensor_value val;

    // fetch the latest sample from the sensor
	int8_t ret = sensor_sample_fetch(dev);
    if (ret < 0 && ret != -EBADMSG) { 
	    printk("SHT31 device sample is not up to date. error: %d\n", ret);
	    return 0;
    }

    // retrieve the ambient temperature from the sensor
	ret = sensor_channel_get(dev, SENSOR_CHAN_AMBIENT_TEMP, &val);
    if (ret < 0) {
        printk("can't read sensor channels. error: %d\n", ret);
	    return 0;
    }

    // convert the raw temperature value to integer format with scaling
    int32_t temp = (val.val1 * TEMP_SCALE) + ((int64_t)val.val2 * TEMP_SCALE / 1000000);

    // print the temperature value with two decimal places
    printk("SHT31 temperature: %d.%02d °C\n", temp / TEMP_SCALE, temp % TEMP_SCALE);
    return (int16_t)temp;
}

//  ========== app_sht31_get_hum ===========================================================
int16_t app_get_hum(const struct device *dev)
{
    struct sensor_value val;

    // fetch the latest sample from the sensor
	int8_t ret = sensor_sample_fetch(dev);
    if (ret < 0 && ret != -EBADMSG) { 
	    printk("SHT31 device sample is not up to date. error: %d\n", ret);
	    return 0;
    }

    // retrieve the humidity from the sensor
	ret = sensor_channel_get(dev, SENSOR_CHAN_HUMIDITY, &val);
    if (ret < 0) {
        printk("can't read sensor channels. error: %d\n", ret);
	    return 0;
    }

    // convert the raw humicity value to integer format with scaling
    int32_t hum = (val.val1 * HUM_SCALE) + ((int64_t)val.val2 * HUM_SCALE / 1000000);

    // print the humifity value with two decimal places
    printk("SHT31 humidity: %d.%02d %%RH\n", hum / HUM_SCALE, hum % HUM_SCALE);
    return (int16_t)hum;
}
```

## src/app_sht31.h
```c
/*
 * Copyright (c) 2025
 * Regis Rousseau
 * Univ Lyon, INSA Lyon, Inria, CITI, EA3720
 * SPDX-License-Identifier: Apache-2.0
 */

#ifndef APP_SHT31_H
#define APP_SHT31_H

//  ========== includes ====================================================================
#include <zephyr/kernel.h>
#include <zephyr/device.h>
#include <zephyr/devicetree.h>
#include <zephyr/drivers/sensor.h>
#include <stdint.h>

//  ========== defines =====================================================================
#define TEMP_SCALE  100     // scale for converting to int6_t
#define HUM_SCALE   100     // scale for converting to int16_t
             
//  ========== prototypes ==================================================================
int16_t app_sht_get_temp(const struct device *dev);
int16_t app_sht_get_hum(const struct device *dev);

#endif /* APP_SHT31_H */
```

## src/app_vbat.c
```c
/*
 * Copyright (c) 2025
 * Regis Rousseau
 * Univ Lyon, INSA Lyon, Inria, CITI, EA3720
 * SPDX-License-Identifier: Apache-2.0
 */


//  ========== includes ====================================================================
#include "app_vbat.h"

//  ========== globals =====================================================================
// ADC buffer to store raw ADC readings
int32_t buf;

// ADC channel configuration obtained from the device tree
static const struct adc_dt_spec adc_channel = ADC_DT_SPEC_GET(DT_PATH(zephyr_user));

// ADC sequence configuration to specify the ADC operation
static struct adc_sequence sequence = {
    .channels = 1,
	.buffer = &buf,
	.buffer_size = sizeof(buf),
};

// nonlinear mapping via lookup table
// source: https://www.jackery.com/blogs/knowledge/battery-voltage-chart
static const struct {
        float voltage;
        uint8_t percent;
} soc_table[] = {
    {4.20f, 100},
    {4.05f,  90},
    {3.95f,  80},
    {3.85f,  70},
    {3.80f,  60},
    {3.75f,  50},
    {3.70f,  40},
    {3.65f,  30},
    {3.55f,  20},
    {3.40f,  10},
    {3.00f,   0}
};

//  ========== app_nrf52_vbat_init =========================================================
int8_t app_adc_init()
{
    int8_t ret;

    // verify if the ADC is ready for operation
    if (!adc_is_ready_dt(&adc_channel)) {
		printk("ADC is not ready. error: %d\n", ret);
		return 0;
	}

    // configure the ADC channel settings
    ret = adc_channel_setup_dt(&adc_channel);
	if (ret < 0) {
		printk("failed to set up ADC channel. error: %d\n", ret);
		return 0;
	}

    // initialize the ADC sequence for continuous or single readings
    ret = adc_sequence_init_dt(&adc_channel, &sequence);
	if (ret < 0) {
		printk("failed to initialize ADC sequence. error: %d\n", ret);
		return 0;
	}
    return 1;
}

//  ======== app_nrf52_get_vbat ============================================================
int16_t app_adc_get_bat()
{
    int16_t percent = 0;

    // read sample from the ADC
    int8_t ret = adc_read(adc_channel.dev, &sequence);
    if (ret < 0 ) {        
	    printk("raw adc value is not up to date. error: %d\n", ret);
	    return 0;
    }
    printk("raw adc value: %d\n", buf);

    // convert raw ADC reading to voltage
    int32_t v_adc = (buf * ADC_FULL_SCALE_MV) / ADC_RESOLUTION;
    printk("convert voltage AIN1: %d mV\n", v_adc);

    // scale back to actual battery voltage using voltage divider
    int32_t v_bat = (v_adc * DIVIDER_RATIO_NUM) / DIVIDER_RATIO_DEN;
    printk("convert voltage BATT: %d mv\n", v_bat);

    // convert to volts
    float vbat = v_bat / 1000.0f;  

    // convert to volts for lookup
    uint8_t soc = 0;
    if (vbat >= soc_table[0].voltage) {
        soc = 100;
    } else if (vbat <= soc_table[sizeof(soc_table)/sizeof(soc_table[0]) - 1].voltage) {
        soc = 0;
    } else {
        for (int i = 0; i < (int)(sizeof(soc_table)/sizeof(soc_table[0]) - 1); i++) {
            float v1 = soc_table[i].voltage;
            float v2 = soc_table[i+1].voltage;
            if (vbat <= v1 && vbat >= v2) {
                float p1 = soc_table[i].percent;
                float p2 = soc_table[i+1].percent;
                soc = (uint8_t)(p1 + (vbat - v1)*(p2 - p1)/(v2 - v1));
                break;
            }
        }
    }

    percent = soc;
    printk("battery level: %d %%\n", percent);
    return percent;
}
```

## src/app_vbat.h
```c
/*
 * Copyright (c) 2025
 * Regis Rousseau
 * Univ Lyon, INSA Lyon, Inria, CITI, EA3720
 * SPDX-License-Identifier: Apache-2.0
 */

#ifndef APP_VBAT_H
#define APP_VBAT_H

//  ========== includes ====================================================================
#include <zephyr/kernel.h>
#include <zephyr/device.h>
#include <zephyr/devicetree.h>
#include <zephyr/drivers/adc.h>
#include <math.h>

//  ========== defines =====================================================================
// ADC characteristics (nRF52 SAADC)
#define ADC_REF_INTERNAL_MV         600     // 0.6 V internal reference
#define ADC_GAIN                    6       // using ADC_GAIN_1_6 -> 1/6
#define ADC_RESOLUTION              4096    // 12-bit

// effective full-scale voltage in mV
#define ADC_FULL_SCALE_MV   ((ADC_REF_INTERNAL_MV * ADC_GAIN))  // 3600 mV full scale

// voltage divider correction
#define DIVIDER_RATIO_NUM           4600    // (R4 + R5)
#define DIVIDER_RATIO_DEN           3600    // R5

//  ========== prototypes ==================================================================
int8_t app_adc_init();
int16_t app_adc_get_bat();

#endif /* APP_VBAT_H */
```
